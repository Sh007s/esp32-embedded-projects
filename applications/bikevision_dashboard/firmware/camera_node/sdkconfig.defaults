## applications/bikevision_dashboard/firmware/display_node/sdkconfig.defaults
```kconfig
CONFIG_PARTITION_TABLE_CUSTOM=y
CONFIG_PARTITION_TABLE_CUSTOM_FILENAME="partitions.csv"
CONFIG_ESPTOOLPY_FLASHSIZE_4MB=y
CONFIG_ESP_DEFAULT_CPU_FREQ_MHZ_240=y
CONFIG_COMPILER_OPTIMIZATION_PERF=y
```

## prototypes/esp32/esp_camera/camera_test/main/Kconfig.projbuild
```kconfig
menu "Camera Wi-Fi Configuration"

    config ESP_WIFI_SSID
        string "WiFi SSID"
        default ""
        help
            WiFi network name.

    config ESP_WIFI_PASSWORD
        string "WiFi Password"
        default ""
        help
            WiFi network password.

    config ESP_MAXIMUM_RETRY
        int "Maximum WiFi retry"
        range 1 20
        default 5
        help
            Maximum number of WiFi connection retries.

endmenu
```

## prototypes/esp32/espnow/sender_node/main/Kconfig.projbuild
```kconfig
menu "ESP-NOW link test"

    config LINK_WIFI_SSID
        string "Wi-Fi SSID (router or hotspot)"
        default "myssid"
        help
            Both boards must join the same network so they share one Wi-Fi
            channel, which ESP-NOW needs.

    config LINK_WIFI_PASSWORD
        string "Wi-Fi password"
        default "mypassword"

    config LINK_TEST_PACKETS
        int "Packets per test run"
        range 10 2000
        default 1000
        help
            Only used by sender_node.

    config LINK_TEST_INTERVAL_S
        int "Seconds between test runs"
        range 1 600
        default 10
        help
            Only used by sender_node.

endmenu
```
